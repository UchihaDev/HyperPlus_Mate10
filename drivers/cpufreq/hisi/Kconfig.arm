## drivers/cpufreq/hisi/Kconfig.arm
```kconfig
config ARCH_HISI_MAXFREQ
	bool "Hisilicon platform cpu max freq recognition"
	depends on PM_OPP
	default n
	help
	  Hisilicon platform cpu max freq recognition.

config HISI_ENABLE_GET_VAL
	bool "Hisilicon get cpufreq param"
	default n
	help
	  Hisilicon get cpufreq param.

config HISI_ENABLE_HPM_DATA_COLLECT
	bool "Hisilicon get hpm volt param"
	depends on HISI_ENABLE_GET_VAL
	default n
	help
	  Hisilicon get avs hpm volt param.

config HISI_BIG_MAXFREQ_HOTPLUG
	tristate "Specific flow for Hisilicon Platform CPUfreq driver"
	depends on ARM_BIG_LITTLE_CPUFREQ && HOTPLUG_CPU
	help
	  This add Hotplug Flow in CPUfreq for Hisilicon Big-little Platform with boost freq.

config HISI_CPUFREQ_DT
	bool "Hisilicon cpufreq-dt enable"
	depends on CPUFREQ_DT
	default n
	help
	  Hisilicon cpufreq-dt enable.

config HISI_HW_VOTE_CPU_FREQ
	bool "Hisilicon cpufreq-hw_vote enable"
	depends on HISI_CPUFREQ_DT
	default n
	help
	  Hisilicon cpufreq-hw_vote enable.

config HISI_CPUDDR_FREQ_LINK
	bool "Hisilicon cpu ddr freq link enable"
	depends on CPUFREQ_DT
	default n
	help
	  Hisilicon cpu ddr freq link enable.

config CPU_FREQ_POWER_STAT
	bool "Estimation of task power consumption"
	depends on CPU_FREQ_STAT
	default n
	help
	  Keep track of amount of power each task consumes and report power per uid
```

## kernel/drivers/media/huawei/camera/platform/kirin660/Kconfig
```kconfig
comment "Huawei Sensor kirin660"

source "drivers/media/huawei/camera/sensor/vcm/Kconfig"
source "drivers/media/huawei/camera/sensor/flash/Kconfig"
source "drivers/media/huawei/camera/sensor/ois/Kconfig"


config HUAWEI_CAMERA_USE_OV8865
	bool "ov8865"
    default y
	depends on HUAWEI_CAMERA

config HUAWEI_CAMERA_USE_IMX286HYBIRD
	bool "imx286hybird"
    default y
	depends on HUAWEI_CAMERA
```
